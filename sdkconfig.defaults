## sdkconfig.defaults
```kconfig
# ESP32-P4 uses the ESP32-C6 co-processor through esp_wifi_remote/esp_hosted.
# ESP_HOST_WIFI_ENABLED and ESP_WIFI_REMOTE_ENABLED are mutually exclusive in
# the esp_wifi_remote component Kconfig.
# CONFIG_ESP_HOST_WIFI_ENABLED is not set
CONFIG_ESP_WIFI_REMOTE_ENABLED=y
CONFIG_ESP_WIFI_REMOTE_LIBRARY_HOSTED=y
CONFIG_SLAVE_IDF_TARGET_ESP32C6=y
CONFIG_ESP_HOSTED_ENABLED=y
CONFIG_ESP_HOSTED_SDIO_HOST_INTERFACE=y
CONFIG_ESP_WIFI_STATIC_RX_BUFFER_NUM=10
CONFIG_ESP_WIFI_DYNAMIC_RX_BUFFER_NUM=32
CONFIG_ESP_WIFI_TX_BUFFER_TYPE=1
CONFIG_ESP_WIFI_DYNAMIC_TX_BUFFER_NUM=32
CONFIG_ESP_WIFI_DYNAMIC_RX_MGMT_BUF=y
CONFIG_ESP_WIFI_RX_MGMT_BUF_NUM_DEF=8
CONFIG_ESP_WIFI_ESPNOW_MAX_ENCRYPT_NUM=7
```
